## layers/meta-balena-turing-rk1/conf/layer.conf
```bitbake
# We have a conf and classes directory, add to BBPATH
BBPATH .= ":${LAYERDIR}"

# We have recipes-* directories, add to BBFILES
BBFILES += "${LAYERDIR}/recipes-*/*/*.bb \
            ${LAYERDIR}/recipes-*/*/*.bbappend"

BBFILE_COLLECTIONS += "meta-balena-turing-rk1"
BBFILE_PATTERN_meta-balena-turing-rk1 = "^${LAYERDIR}/"
BBFILE_PRIORITY_meta-balena-turing-rk1 = "10"

LAYERDEPENDS_meta-balena-turing-rk1 = "core balena-common"
LAYERSERIES_COMPAT_meta-balena-turing-rk1 = "scarthgap"
```

## meta-turing-rk1/conf/layer.conf
```bitbake
# We have a conf and classes directory, add to BBPATH
BBPATH .= ":${LAYERDIR}"

# We have recipes-* directories, add to BBFILES
BBFILES += "${LAYERDIR}/recipes-*/*/*.bb \
            ${LAYERDIR}/recipes-*/*/*.bbappend"

BBFILE_COLLECTIONS += "meta-turing-rk1"
BBFILE_PATTERN_meta-turing-rk1 = "^${LAYERDIR}/"
BBFILE_PRIORITY_meta-turing-rk1 = "6"

LAYERDEPENDS_meta-turing-rk1 = "core"
LAYERSERIES_COMPAT_meta-turing-rk1 = "scarthgap"
```

## meta-turing-rk1/conf/machine/turing-rk1.conf
```bitbake
# Copyright (c) 2025, Turing Machines
# Based on RK3588 EVB configuration
# Released under the MIT license

#@TYPE: Machine
#@NAME: Turing RK1

# Inherit from RK3588 base configuration (similar to rk3588-evb)
require conf/machine/include/rk3588.inc

# Use Rockchip BSP kernel with full RK3588 hardware support
PREFERRED_PROVIDER_virtual/kernel = "linux-rockchip"

# Turing RK1 specific device tree
KERNEL_DEVICETREE = "rockchip/rk3588-turing-rk1.dtb"

# Use native Turing RK1 U-Boot defconfig (created from rock5b base with UART9 support)
UBOOT_MACHINE = "turing-rk1-rk3588_defconfig"

# Turing RK1 uses UART9 for serial console (ONLY accessible port in Turing Pi chassis)
SERIAL_CONSOLES = "115200;ttyS9"
```
